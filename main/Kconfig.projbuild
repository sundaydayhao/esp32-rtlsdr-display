## main/Kconfig.projbuild
```kconfig
menu "RTL-SDR Waterfall"

    menu "Radio"
        config RTLSDR_BASEBAND_INIT
            bool "Run RTL2832U baseband initialization"
            default y
            help
                Sends a compact RTL2832U baseband startup sequence before streaming.
                Common R820T/R820T2/R828D tuner PLL control is configured after
                the RTL2832U baseband path is initialized.

        config RTLSDR_CENTER_FREQ_HZ
            int "Center frequency in Hz"
            default 100000000
            help
                Initial center frequency. Runtime changes from the Waterfall UI
                are sent to the RTL-SDR task and applied to supported R820T/R828D
                tuners.

        config RTLSDR_SAMPLE_RATE
            int "Sample rate in samples per second"
            default 1024000
            range 225001 2400000
            help
                RTL2832U complex sample rate. Start low during bring-up.

        config RTLSDR_BULK_TRANSFER_SIZE
            int "USB bulk transfer size in bytes"
            default 16384
            range 4096 65536

        config RTLSDR_NUM_TRANSFERS
            int "Queued USB bulk transfers"
            default 4
            range 2 8

        config RTLSDR_TUNER_GAIN_TENTHS_DB
            int "Tuner gain in tenths of dB"
            default 0
            help
                Zero uses R820T/R828D automatic gain. Non-zero enables a simple
                manual R82xx gain split across LNA and mixer stages.
    endmenu

    menu "FFT"
        config WATERFALL_FFT_SIZE
            int "FFT size"
            default 512
            range 64 1024
            help
                Must be a power of two. Larger values give better frequency resolution but use more CPU.

        config WATERFALL_AVERAGE_SHIFT
            int "Magnitude averaging shift"
            default 2
            range 0 6
            help
                Higher values smooth the display more.

        config WATERFALL_TARGET_FPS
            int "Waterfall display refresh rate"
            default 20
            range 1 60
            help
                Limits how many FFT lines per second are rendered. The SDR stream is
                still consumed continuously, but intermediate FFT windows are skipped
                so the LCD task does not starve the idle task watchdog.

        config WATERFALL_DB_MIN
            int "Waterfall minimum dB"
            default -80

        config WATERFALL_DB_MAX
            int "Waterfall maximum dB"
            default -20
    endmenu

    menu "FM Receiver"
        config FM_RECEIVER_NFM_MODE
            bool "Use narrowband FM mode"
            default n
            help
                Uses narrowband FM voice parameters. Leave disabled for broadcast
                wideband FM reception.

        config FM_RECEIVER_AUDIO_RATE_HZ
            int "FM audio sample rate in Hz"
            default 48000
            range 8000 96000
            help
                PCM output sample rate after FM demodulation.

        config FM_RECEIVER_VOLUME_PERCENT
            int "FM audio volume percent"
            default 80
            range 0 150

        config FM_RECEIVER_AUDIO_OUTPUT
            bool "Enable Korvo-1 speaker audio output"
            default y
            help
                Sends FM mono PCM to the ESP32-S31-Korvo-1 onboard ES8389 codec
                and NS4150B speaker amplifier.

        config FM_RECEIVER_AUDIO_I2C_PORT
            int "Audio codec I2C port"
            depends on FM_RECEIVER_AUDIO_OUTPUT
            default 0
            range 0 1

        config FM_RECEIVER_AUDIO_I2C_SDA_GPIO
            int "Audio codec I2C SDA GPIO"
            depends on FM_RECEIVER_AUDIO_OUTPUT
            default 0

        config FM_RECEIVER_AUDIO_I2C_SCL_GPIO
            int "Audio codec I2C SCL GPIO"
            depends on FM_RECEIVER_AUDIO_OUTPUT
            default 1

        config FM_RECEIVER_AUDIO_I2S_PORT
            int "Audio I2S port"
            depends on FM_RECEIVER_AUDIO_OUTPUT
            default 1
            range 0 2

        config FM_RECEIVER_AUDIO_I2S_MCLK_GPIO
            int "Audio I2S MCLK GPIO (-1 if unused)"
            depends on FM_RECEIVER_AUDIO_OUTPUT
            default -1

        config FM_RECEIVER_AUDIO_I2S_BCLK_GPIO
            int "Audio I2S BCLK/SCLK GPIO"
            depends on FM_RECEIVER_AUDIO_OUTPUT
            default 3

        config FM_RECEIVER_AUDIO_I2S_WS_GPIO
            int "Audio I2S WS/LRCLK GPIO"
            depends on FM_RECEIVER_AUDIO_OUTPUT
            default 4

        config FM_RECEIVER_AUDIO_I2S_DOUT_GPIO
            int "Audio I2S DOUT GPIO"
            depends on FM_RECEIVER_AUDIO_OUTPUT
            default 5

        config FM_RECEIVER_AUDIO_I2S_DIN_GPIO
            int "Audio I2S DIN GPIO"
            depends on FM_RECEIVER_AUDIO_OUTPUT
            default 6

        config FM_RECEIVER_AUDIO_PA_GPIO
            int "Audio speaker PA enable GPIO"
            depends on FM_RECEIVER_AUDIO_OUTPUT
            default 7
    endmenu

    menu "LCD"
        config LCD_H_RES
            int "LCD horizontal resolution"
            default 800

        config LCD_V_RES
            int "LCD vertical resolution"
            default 480

        config LCD_PIXEL_CLOCK_HZ
            int "LCD pixel clock in Hz"
            default 18000000

        config LCD_HSYNC
            int "HSYNC pulse width"
            default 1

        config LCD_HBP
            int "Horizontal back porch"
            default 40

        config LCD_HFP
            int "Horizontal front porch"
            default 20

        config LCD_VSYNC
            int "VSYNC pulse width"
            default 1

        config LCD_VBP
            int "Vertical back porch"
            default 10

        config LCD_VFP
            int "Vertical front porch"
            default 5

        config LCD_PCLK_ACTIVE_NEG
            bool "Clock LCD data on falling PCLK edge"
            default y

        config LCD_DATA_WIDTH
            int "RGB data width"
            default 16
            range 16 16

        config LCD_PCLK_GPIO
            int "PCLK GPIO"
            default 40

        config LCD_DE_GPIO
            int "DE GPIO"
            default 43

        config LCD_HSYNC_GPIO
            int "HSYNC GPIO"
            default 44

        config LCD_VSYNC_GPIO
            int "VSYNC GPIO"
            default 45

        config LCD_DATA0_GPIO
            int "DATA0 GPIO"
            default 8
        config LCD_DATA1_GPIO
            int "DATA1 GPIO"
            default 9
        config LCD_DATA2_GPIO
            int "DATA2 GPIO"
            default 10
        config LCD_DATA3_GPIO
            int "DATA3 GPIO"
            default 11
        config LCD_DATA4_GPIO
            int "DATA4 GPIO"
            default 12
        config LCD_DATA5_GPIO
            int "DATA5 GPIO"
            default 13
        config LCD_DATA6_GPIO
            int "DATA6 GPIO"
            default 14
        config LCD_DATA7_GPIO
            int "DATA7 GPIO"
            default 15
        config LCD_DATA8_GPIO
            int "DATA8 GPIO"
            default 16
        config LCD_DATA9_GPIO
            int "DATA9 GPIO"
            default 17
        config LCD_DATA10_GPIO
            int "DATA10 GPIO"
            default 18
        config LCD_DATA11_GPIO
            int "DATA11 GPIO"
            default 19
        config LCD_DATA12_GPIO
            int "DATA12 GPIO"
            default 33
        config LCD_DATA13_GPIO
            int "DATA13 GPIO"
            default 34
        config LCD_DATA14_GPIO
            int "DATA14 GPIO"
            default 35
        config LCD_DATA15_GPIO
            int "DATA15 GPIO"
            default 36
    endmenu

    menu "LVGL"
        config LVGL_DRAW_BUF_LINES
            int "LVGL draw buffer lines"
            default 40
            range 8 120
            help
                Number of LCD lines in the partial LVGL draw buffer.

        config LVGL_TASK_STACK_SIZE
            int "LVGL task stack size"
            default 8192
            range 4096 16384

        config LVGL_TASK_PRIORITY
            int "LVGL task priority"
            default 2
            range 1 10
    endmenu

    menu "Touch"
        config TOUCH_ENABLED
            bool "Enable I2C touch input"
            default y
            help
                Enables LVGL pointer input from an I2C capacitive touch controller.
                GT911 and FT5x06-compatible controllers are probed at boot.

        config TOUCH_I2C_PORT
            int "Touch I2C port"
            depends on TOUCH_ENABLED
            default 0
            range 0 1

        config TOUCH_I2C_SDA_GPIO
            int "Touch I2C SDA GPIO"
            depends on TOUCH_ENABLED
            default 0

        config TOUCH_I2C_SCL_GPIO
            int "Touch I2C SCL GPIO"
            depends on TOUCH_ENABLED
            default 1

        config TOUCH_I2C_FREQ_HZ
            int "Touch I2C clock frequency"
            depends on TOUCH_ENABLED
            default 400000
            range 100000 400000

        config TOUCH_GT911_ADDR
            hex "GT911 I2C address"
            depends on TOUCH_ENABLED
            default 0x14

        config TOUCH_FT5X06_ADDR
            hex "FT5x06 I2C address"
            depends on TOUCH_ENABLED
            default 0x38

        config TOUCH_INT_GPIO
            int "Touch INT GPIO (-1 if unused)"
            depends on TOUCH_ENABLED
            default -1

        config TOUCH_RST_GPIO
            int "Touch RST GPIO (-1 if unused)"
            depends on TOUCH_ENABLED
            default -1

        config TOUCH_SWAP_XY
            bool "Swap touch X/Y"
            depends on TOUCH_ENABLED
            default n

        config TOUCH_MIRROR_X
            bool "Mirror touch X"
            depends on TOUCH_ENABLED
            default n

        config TOUCH_MIRROR_Y
            bool "Mirror touch Y"
            depends on TOUCH_ENABLED
            default n
    endmenu

endmenu
```

## sdkconfig.defaults
```kconfig
CONFIG_IDF_TARGET="esp32s31"
CONFIG_PARTITION_TABLE_CUSTOM=y
CONFIG_PARTITION_TABLE_CUSTOM_FILENAME="partitions.csv"
CONFIG_PARTITION_TABLE_FILENAME="partitions.csv"
CONFIG_ESP_DEFAULT_CPU_FREQ_MHZ_240=y
CONFIG_ESP_MAIN_TASK_STACK_SIZE=8192
CONFIG_FREERTOS_HZ=1000
CONFIG_SPIRAM=y
CONFIG_SPIRAM_USE_MALLOC=y
CONFIG_SPIRAM_MALLOC_ALWAYSINTERNAL=16384
CONFIG_USB_HOST_ENABLE_ENUM_FILTER_CALLBACK=y
CONFIG_USB_HOST_DEBOUNCE_DELAY_MS=800
CONFIG_USB_HOST_RESET_HOLD_MS=100
CONFIG_USB_HOST_RESET_RECOVERY_MS=250
CONFIG_USB_HOST_SET_ADDR_RECOVERY_MS=50
CONFIG_COMPILER_OPTIMIZATION_PERF=y
CONFIG_RTLSDR_SAMPLE_RATE=288000
CONFIG_RTLSDR_BULK_TRANSFER_SIZE=4096
CONFIG_RTLSDR_NUM_TRANSFERS=8
CONFIG_WATERFALL_TARGET_FPS=20
CONFIG_FM_RECEIVER_AUDIO_RATE_HZ=48000
CONFIG_FM_RECEIVER_VOLUME_PERCENT=35
# CONFIG_FM_RECEIVER_NFM_MODE is not set
CONFIG_FM_RECEIVER_AUDIO_OUTPUT=y
CONFIG_FM_RECEIVER_AUDIO_I2C_PORT=0
CONFIG_FM_RECEIVER_AUDIO_I2C_SDA_GPIO=0
CONFIG_FM_RECEIVER_AUDIO_I2C_SCL_GPIO=1
CONFIG_FM_RECEIVER_AUDIO_I2S_PORT=1
CONFIG_FM_RECEIVER_AUDIO_I2S_MCLK_GPIO=-1
CONFIG_FM_RECEIVER_AUDIO_I2S_BCLK_GPIO=3
CONFIG_FM_RECEIVER_AUDIO_I2S_WS_GPIO=4
CONFIG_FM_RECEIVER_AUDIO_I2S_DOUT_GPIO=5
CONFIG_FM_RECEIVER_AUDIO_I2S_DIN_GPIO=6
CONFIG_FM_RECEIVER_AUDIO_PA_GPIO=7
# CONFIG_CODEC_ES8311_SUPPORT is not set
# CONFIG_CODEC_ES7210_SUPPORT is not set
# CONFIG_CODEC_ES7243_SUPPORT is not set
# CONFIG_CODEC_ES7243E_SUPPORT is not set
# CONFIG_CODEC_ES8156_SUPPORT is not set
# CONFIG_CODEC_AW88298_SUPPORT is not set
CONFIG_CODEC_ES8389_SUPPORT=y
# CONFIG_CODEC_ES8374_SUPPORT is not set
# CONFIG_CODEC_ES8388_SUPPORT is not set
# CONFIG_CODEC_TAS5805M_SUPPORT is not set
```
